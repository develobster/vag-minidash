## firmware/main/Kconfig.projbuild
```kconfig
menu "MiniDash display and UI"
    config MINIDASH_DEEP_SLEEP
        bool "Deep sleep on CAN silence (requires reviewed wake/power wiring)"
        depends on MINIDASH_CAN_ENABLE && !FREERTOS_UNICORE
        default n
        help
            CAN silence is not ignition evidence on a filtered OBD gateway.
            Verify this policy in the vehicle before enabling. This does not
            power off the buck converter or the CAN transceiver.
    config MINIDASH_CAN_SLEEP_SECONDS
        int "CAN silence before deep sleep, seconds"
        depends on MINIDASH_DEEP_SLEEP
        range 15 300
        default 20
    config MINIDASH_WAKE_GPIO
        int "RTC wake input, -1 for timer only"
        depends on MINIDASH_DEEP_SLEEP
        range -1 21
        default -1
    config MINIDASH_WAKE_LEVEL
        int "Wake GPIO active level (CAN RX must use 0)"
        depends on MINIDASH_DEEP_SLEEP
        range 0 1
        default 0
    config MINIDASH_WAKE_SECONDS
        int "Fallback timer wake interval, seconds"
        depends on MINIDASH_DEEP_SLEEP
        range 10 3600
        default 300
    config MINIDASH_SERVICE_MODE
        bool "Service boot: permit manual AP without measured speed"
        default n
        help
            For a disconnected bench or stationary service only. An observed
            positive speed stops Wi-Fi even in this mode. AP is never automatic.
    config MINIDASH_CAN_ENABLE
        bool "Standalone CAN acquisition (review wiring first)"
        depends on !FREERTOS_UNICORE
        default n
    config MINIDASH_CAN_TX_GPIO
        int "CAN TX GPIO"
        depends on MINIDASH_CAN_ENABLE
        default -1
    config MINIDASH_CAN_RX_GPIO
        int "CAN RX GPIO"
        depends on MINIDASH_CAN_ENABLE
        default -1
    config MINIDASH_STANDARD_OBD
        bool "Allow standard read-only OBD-II, 11-bit 500 kbit/s"
        depends on MINIDASH_CAN_ENABLE
        default n
        help
            Reviewed installation preset. No manufacturer profile ships enabled.
            Disabled means hardware listen-only, with no ACK or diagnostic TX.
    config MINIDASH_HOST_INJECTION
        bool "Development USB telemetry injection"
        depends on !MINIDASH_CAN_ENABLE
        default y
    config MINIDASH_CAR_VALIDATION_MODE
        bool "Car validation: bounded read-only polling and evidence trace"
        depends on MINIDASH_CAN_ENABLE
        default n
        help
            Preserves all read-only and identity gates. At most four application
            requests per second; required ISO-TP flow control is separate.
            CAN without STANDARD_OBD remains hardware listen-only, with zero TX.
            Captures bounded raw/decoded exchanges for the local evidence API.
    config MINIDASH_DISPLAY_ENABLE
        bool "Enable MiniDash SPI display and production UI"
        default n
        help
            Enable the display only after checking the module voltage and wiring.
            Use sdkconfig.standalone to run CAN acquisition on this device.

    choice MINIDASH_LCD_CONTROLLER
        prompt "SPI display controller"
        depends on MINIDASH_DISPLAY_ENABLE
        default MINIDASH_LCD_CONTROLLER_ST7789

    config MINIDASH_LCD_CONTROLLER_ILI9341
        bool "ILI9341"

    config MINIDASH_LCD_CONTROLLER_ST7789
        bool "ST7789"
    endchoice

    config MINIDASH_DISPLAY_SMOKE_TEST
        bool "Run RGB/black display smoke test on boot"
        depends on MINIDASH_DISPLAY_ENABLE
        default n

    config MINIDASH_DISPLAY_ROTATION
        int "Display rotation (controller-native orientation at 0)"
        range 0 3
        default 2

    config MINIDASH_LCD_X_GAP
        int "Display X RAM offset"
        range 0 320
        default 0
    config MINIDASH_LCD_Y_GAP
        int "Display Y RAM offset"
        range 0 320
        default 0
    config MINIDASH_LCD_INVERT
        bool "Invert display colors if required by the delivered module"
        default n

    config MINIDASH_LCD_PIN_SCLK
        int "SPI clock GPIO (-1 = unconfirmed)"
        range -1 48
        default -1
    config MINIDASH_LCD_PIN_MOSI
        int "SPI MOSI GPIO (-1 = unconfirmed)"
        range -1 48
        default -1
    config MINIDASH_LCD_PIN_MISO
        int "SPI MISO GPIO (-1 = not connected)"
        range -1 48
        default -1
    config MINIDASH_LCD_PIN_CS
        int "Display CS GPIO (-1 = unconfirmed)"
        range -1 48
        default -1
    config MINIDASH_LCD_PIN_DC
        int "Display DC GPIO (-1 = unconfirmed)"
        range -1 48
        default -1
    config MINIDASH_LCD_PIN_RST
        int "Display RESET GPIO (-1 = not connected)"
        range -1 48
        default -1
    config MINIDASH_LCD_PIN_BL
        int "Backlight LEDC PWM GPIO (-1 = unavailable)"
        range -1 48
        default -1
    config MINIDASH_LCD_BL_ACTIVE_HIGH
        bool "Backlight GPIO active high"
        default y

    config MINIDASH_TOUCH_ENABLE
        bool "Enable XPT2046 resistive touch"
        depends on MINIDASH_DISPLAY_ENABLE
        default n
    config MINIDASH_TOUCH_PIN_CS
        int "XPT2046 chip select GPIO (-1 = disabled)"
        range -1 48
        depends on MINIDASH_TOUCH_ENABLE
        default -1
    config MINIDASH_TOUCH_DEBUG_OVERLAY
        bool "Show touch zones and mapped coordinates (development only)"
        depends on MINIDASH_TOUCH_ENABLE
        default n
endmenu
```

## firmware/sdkconfig.defaults
```kconfig
CONFIG_IDF_TARGET="esp32s3"
CONFIG_ESPTOOLPY_FLASHSIZE_16MB=y
CONFIG_ESPTOOLPY_FLASHMODE_QIO=y
CONFIG_ESPTOOLPY_FLASHFREQ_80M=y
CONFIG_PARTITION_TABLE_CUSTOM=y
CONFIG_PARTITION_TABLE_CUSTOM_FILENAME="partitions.csv"
CONFIG_SPIRAM=y
CONFIG_SPIRAM_MODE_OCT=y
CONFIG_SPIRAM_SPEED_80M=y
CONFIG_SPIRAM_BOOT_INIT=y
CONFIG_SPIRAM_USE_MALLOC=y
CONFIG_ESP_CONSOLE_USB_SERIAL_JTAG=y
CONFIG_ESP_WIFI_NVS_ENABLED=n
CONFIG_BT_ENABLED=y
CONFIG_BT_BLUEDROID_ENABLED=n
CONFIG_BT_CONTROLLER_ONLY=y
CONFIG_ESP_TASK_WDT_EN=y
CONFIG_ESP_TASK_WDT_INIT=y
CONFIG_ESP_MAIN_TASK_STACK_SIZE=8192
CONFIG_MINIDASH_DISPLAY_ENABLE=y
CONFIG_MINIDASH_LCD_CONTROLLER_ST7789=y
CONFIG_MINIDASH_DISPLAY_SMOKE_TEST=n
CONFIG_MINIDASH_DISPLAY_ROTATION=2
CONFIG_MINIDASH_LCD_PIN_SCLK=12
CONFIG_MINIDASH_LCD_PIN_MOSI=11
CONFIG_MINIDASH_LCD_PIN_MISO=13
CONFIG_MINIDASH_LCD_PIN_CS=10
CONFIG_MINIDASH_LCD_PIN_DC=8
CONFIG_MINIDASH_LCD_PIN_RST=9
CONFIG_MINIDASH_LCD_PIN_BL=4
CONFIG_MINIDASH_TOUCH_ENABLE=y
CONFIG_MINIDASH_TOUCH_PIN_CS=14
CONFIG_LV_USE_CLIB_MALLOC=y
CONFIG_LV_FONT_MONTSERRAT_10=y
CONFIG_LV_FONT_MONTSERRAT_12=y
CONFIG_LV_FONT_MONTSERRAT_14=y
CONFIG_LV_FONT_MONTSERRAT_16=y
CONFIG_LV_FONT_MONTSERRAT_20=y
CONFIG_LV_FONT_MONTSERRAT_28=y
CONFIG_LV_FONT_MONTSERRAT_48=y
CONFIG_LV_BUILD_EXAMPLES=n
CONFIG_LV_BUILD_DEMOS=n

CONFIG_LV_USE_BAR=y
CONFIG_LV_USE_CHART=y
CONFIG_SPIRAM_MALLOC_ALWAYSINTERNAL=0
CONFIG_SPIRAM_MALLOC_RESERVE_INTERNAL=98304
CONFIG_SPIRAM_TRY_ALLOCATE_WIFI_LWIP=y
CONFIG_ESP_WIFI_STATIC_RX_BUFFER_NUM=6
CONFIG_ESP_WIFI_DYNAMIC_RX_BUFFER_NUM=16
CONFIG_ESP_WIFI_DYNAMIC_TX_BUFFER_NUM=16

# IDF requires BA window <= twice static RX buffers (6).
CONFIG_ESP_WIFI_RX_BA_WIN=12
```
